## boards/arm/cordyceps/Kconfig.defconfig
```kconfig
if BOARD_CORDYCEPS_NRF52833

config BT_CTLR
	default BT

endif # BOARD_CORDYCEPS_NRF52833
```

## boards/arm/cordyceps/cordyceps_defconfig
```kconfig
# Enable MPU
CONFIG_ARM_MPU=y

# Enable RTT
CONFIG_USE_SEGGER_RTT=y

# enable GPIO
CONFIG_GPIO=y

# enable uart driver
CONFIG_SERIAL=y

# enable console and logging via RTT and UART
CONFIG_LOG=y
CONFIG_CONSOLE=y
CONFIG_UART_CONSOLE=y
CONFIG_RTT_CONSOLE=y

# enable pin controller
CONFIG_PINCTRL=y
```

## boards/arm/firefly_v1/Kconfig.defconfig
```kconfig
if BOARD_FIREFLY_V1_NRF52832

config HAS_BT_CTLR
	default BT

endif # BOARD_FIREFLY_V1_NRF52832
```

## boards/arm/lock_v01/Kconfig.defconfig
```kconfig
if BOARD_LOCK_V01_NRF52840

config HAS_BT_CTLR
	default BT

endif # BOARD_LOCK_V01_NRF52840
```

## boards/arm/lock_v01/lock_v01_defconfig
```kconfig
# Enable MPU
CONFIG_ARM_MPU=y

# Enable RTT
CONFIG_USE_SEGGER_RTT=y

# enable GPIO
CONFIG_GPIO=y

# enable uart driver
CONFIG_SERIAL=y

# enable console and logging via RTT and UART
CONFIG_LOG=y
CONFIG_CONSOLE=y
CONFIG_UART_CONSOLE=y
CONFIG_RTT_CONSOLE=y

# I2C is used by eeprom and pill
CONFIG_I2C=y
CONFIG_EEPROM=y
CONFIG_EEPROM_AT24=y

# Required to have smooth LED control
CONFIG_PWM=y

# ADC to measure battery level
CONFIG_ADC=y

# enable pin controller
CONFIG_PINCTRL=y
```

## boards/arm/locket/Kconfig.defconfig
```kconfig
if BOARD_LOCKET

config BOARD
	default "locket"

config UART_1
	default y
	depends on UART_CONSOLE

endif # BOARD_LOCKET
```

## boards/arm/power_meter/Kconfig.defconfig
```kconfig
if BOARD_POWER_METER_NRF52833

config HAS_BT_CTLR
	default BT

endif # BOARD_POWER_METER_NRF52833
```
