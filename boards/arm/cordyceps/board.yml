## boards/arm/cordyceps/board.yml
```yaml
board:
  name: cordyceps
  full_name: Cordyceps
  vendor: arm
  socs:
    - name: nrf52833
```

## boards/arm/firefly_v1/board.yml
```yaml
board:
  name: firefly_v1
  full_name: Firefly v.1
  vendor: arm
  socs:
    - name: nrf52832
```

## boards/arm/lock_v01/board.yml
```yaml
board:
  name: lock_v01
  full_name: Lock v0.1
  vendor: arm
  socs:
    - name: nrf52840
```

## boards/arm/power_meter/board.yml
```yaml
board:
  name: power_meter
  full_name: Power meter
  vendor: arm
  socs:
    - name: nrf52833
```

## firmware/common/Kconfig
```kconfig
# Shared code used by the firmware images. Header-only helpers (eeprom.h,
# persistent.h, sequences.h, ...) are always on the include path and have no
# options here.

config FIREFLY_BATTERY
	bool "Battery level measurement"
	depends on ADC && SOC_FAMILY_NORDIC_NRF

config FIREFLY_BLUETOOTH
	bool "BLE advertising and battery service helpers"
	depends on BT

config FIREFLY_BUZZER
	bool "PWM buzzer"
	depends on PWM
	select FIREFLY_TIMER

config FIREFLY_CC1101
	bool "CC1101 radio driver"
	depends on SPI

config FIREFLY_COLOR
	bool "Color helpers"

config FIREFLY_KEYBOARD
	bool "Matrix keyboard"
	select FIREFLY_TIMER

config FIREFLY_NFC
	bool "MFRC522 NFC reader driver"
	depends on SPI && ZEPHYR_PIGWEED_MODULE
	select PIGWEED_BYTES
	select PIGWEED_CONTAINERS
	select PIGWEED_FUNCTION
	select PIGWEED_SPAN

config FIREFLY_RGB_LED
	bool "PWM RGB LED"
	depends on PWM
	select FIREFLY_COLOR
	select FIREFLY_TIMER

config FIREFLY_ST25R3911B
	bool "ST25R3911B NFC reader driver"
	depends on SPI && ZEPHYR_PIGWEED_MODULE
	select PIGWEED_BYTES
	select PIGWEED_SPAN

config FIREFLY_THREAD
	bool "pw::Function-based thread helper"
	depends on ZEPHYR_PIGWEED_MODULE
	select PIGWEED_FUNCTION

config FIREFLY_TIMER
	bool "pw::Function-based timer"
	depends on ZEPHYR_PIGWEED_MODULE
	select PIGWEED_FUNCTION
```

## manifest/west.yml
```yaml
manifest:
  remotes:
    - name: sdk-nrf
      url-base: https://github.com/nrfconnect
    - name: pigweed
      url-base: https://pigweed.googlesource.com/pigweed
  projects:
    - name: sdk-nrf
      remote: sdk-nrf
      revision: v3.2.6
      path: nrf
      import:
        path-prefix: third_party
        # Only what our images need: sdk-nrf brings in ~50 projects otherwise
        # (Matter, LVGL, OpenThread, TF-M, ...).
        name-allowlist:
          - zephyr
          - nrfxlib
          - hal_nordic
          - cmsis_6
          - segger
          - mbedtls
          - oberon-psa-crypto
    - name: pigweed
      remote: pigweed
      revision: 909513ecf3ab9cbb01160ef38d1649cde88dfb91
      path: third_party/pigweed
```
